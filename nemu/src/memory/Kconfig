## nemu/src/memory/Kconfig
```kconfig
menu "Memory Configuration"

config FLASH_BASE
  hex "flash base address"
  default 0x0        if ISA_x86
  default 0x30000000

config FLASH_SIZE
  hex "flash size"
  default 0x1000000

config SRAM_BASE
  hex "SRAM base address"
  default 0xf000000

config SRAM_SIZE
  hex "SRAM size"
  default 0x2000

config PSRAM_BASE
  hex "PSRAM base address"
  default 0xf000000

config PSRAM_SIZE
  hex "PSRAM size"
  default 0x400000

config SDRAM_BASE
  hex "sdram base address"
  default 0xa0000000

config SDRAM_SIZE
  hex "sdram size"
  default 0x10000000

config PC_RESET_OFFSET
  hex "Offset of reset vector from the base of memory"
  default 0x100000 if ISA_x86
  default 0

choice
  prompt "Physical memory definition"
  default PMEM_GARRAY
config PMEM_MALLOC
  bool "Using malloc()"
config PMEM_GARRAY
  depends on !TARGET_AM
  bool "Using global array"
endchoice

config MEM_RANDOM
  depends on MODE_SYSTEM && !DIFFTEST && !TARGET_AM
  bool "Initialize the memory with random values"
  default y
  help
    This may help to find undefined behaviors.

endmenu #MEMORY
```
